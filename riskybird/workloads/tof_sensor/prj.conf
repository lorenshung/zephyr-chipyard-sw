## CMakeLists.txt
```
# SPDX-License-Identifier: Apache-2.0

cmake_minimum_required(VERSION 3.20.0)

find_package(Zephyr REQUIRED HINTS $ENV{ZEPHYR_BASE})
project(tof_sensor)

target_sources(app PRIVATE src/main.c)
```

## prj.conf
```kconfig
CONFIG_SENSOR=y
CONFIG_BMI08X=y
CONFIG_I2C=y
CONFIG_GPIO=y
CONFIG_STDOUT_CONSOLE=y

# ST VL53L0X support (enables vendor STLIB + driver)
CONFIG_VL53L0X=y
CONFIG_VL53L0X_PROXIMITY_THRESHOLD=100

CONFIG_CBPRINTF_FP_SUPPORT=y

# Debugging (so we can see why init fails)
CONFIG_LOG=y
CONFIG_LOG_MODE_IMMEDIATE=y
CONFIG_LOG_BACKEND_UART=y
CONFIG_SENSOR_LOG_LEVEL_DBG=y
```

## src/main.c
```c
/*
 * SPDX-License-Identifier: Apache-2.0
 */

#include <zephyr/kernel.h>
#include <zephyr/device.h>
#include <zephyr/drivers/i2c.h>
#include <zephyr/drivers/sensor.h>
#include <zephyr/sys/printk.h>

int main(void)
{
	const struct device *const i2c0 = DEVICE_DT_GET(DT_NODELABEL(i2c0));
	const struct device *const vl53l0x_dev = DEVICE_DT_GET_ONE(st_vl53l0x);
	struct sensor_value distance;
	int ret;

	if (!device_is_ready(i2c0)) {
		printk("I2C0: device not ready\n");
	} else {
		/* Quick probe: does anything ACK at 0x29? */
		ret = i2c_write(i2c0, NULL, 0, 0x29);
		printk("I2C0: probe 0x29 %s (ret=%d)\n", (ret == 0) ? "ACK" : "NACK", ret);
	}

	if (!device_is_ready(vl53l0x_dev)) {
		printk("VL53L0X: device not ready\n");
		return 0;
	}

	printk("VL53L0X: device ready, starting measurements\n");

	while (1) {
		ret = sensor_sample_fetch(vl53l0x_dev);
		if (ret < 0) {
			printk("VL53L0X: sensor_sample_fetch failed (%d)\n", ret);
			k_msleep(1000);
			continue;
		}

		ret = sensor_channel_get(vl53l0x_dev, SENSOR_CHAN_DISTANCE, &distance);
		if (ret < 0) {
			printk("VL53L0X: sensor_channel_get failed (%d)\n", ret);
		} else {
			printk("VL53L0X: distance = %lld mm\n",
			       sensor_value_to_milli(&distance));
		}

		k_msleep(1000);
	}

	return 0;
}
```
