## CMakeLists.txt
```
# SPDX-License-Identifier: Apache-2.0

cmake_minimum_required(VERSION 3.20.0)

find_package(Zephyr REQUIRED HINTS $ENV{ZEPHYR_BASE})
project(bmi088_test)

target_sources(app PRIVATE src/main.c)
```

## sample.yaml
```
sample:
  description: RiskyBird BMI088 sensor diagnostic
  name: bmi088 diagnostic
common:
  tags: i2c sensor imu riskybird
tests: {}
```

## prj.conf
```kconfig
CONFIG_SENSOR=y
CONFIG_BMI08X=y
CONFIG_I2C=y

CONFIG_STDOUT_CONSOLE=y
CONFIG_CBPRINTF_FP_SUPPORT=n
CONFIG_LOG=n
```

## src/main.c
```c
/*
 * SPDX-License-Identifier: Apache-2.0
 */

#include <zephyr/kernel.h>
#include <zephyr/device.h>
#include <zephyr/drivers/sensor.h>
#include <zephyr/drivers/i2c.h>
#include <stdio.h>

/* Get device tree nodes for accelerometer and gyroscope
 * The device tree should define aliases:
 *   aliases {
 *     bmi088-accel = &bmi088_accel;
 *     bmi088-gyro = &bmi088_gyro;
 *   };
 */
#define BMI088_ACCEL_NODE DT_ALIAS(bmi088_accel)
#define BMI088_GYRO_NODE DT_ALIAS(bmi088_gyro)

#if !DT_NODE_EXISTS(BMI088_ACCEL_NODE)
#error "BMI088 accelerometer alias 'bmi088-accel' not defined in device tree"
#endif

#if !DT_NODE_EXISTS(BMI088_GYRO_NODE)
#error "BMI088 gyroscope alias 'bmi088-gyro' not defined in device tree"
#endif

static const struct device *accel_dev = DEVICE_DT_GET(BMI088_ACCEL_NODE);
static const struct device *gyro_dev = DEVICE_DT_GET(BMI088_GYRO_NODE);

static void print_sensor_value(const struct sensor_value *value)
{
	int64_t fraction = value->val2;
	uint64_t magnitude = (uint64_t)(fraction < 0 ? -fraction : fraction);

	if (value->val1 == 0 && fraction < 0) {
		printf("-");
	}
	printf("%d.%06u", value->val1, (unsigned int)magnitude);
}

int main(void)
{
	struct sensor_value accel[3], gyro[3], temp;
	int ret;

	printf("BMI088 Sensor Test Application\n");
	printf("==============================\n\n");

	/* Check if accelerometer device is ready */
	if (!device_is_ready(accel_dev)) {
		printf("Error: Accelerometer device is not ready\n");
		return 1;
	}
	printf("Accelerometer device ready: %s\n", accel_dev->name);

	/* Check if gyroscope device is ready */
	if (!device_is_ready(gyro_dev)) {
		printf("Error: Gyroscope device is not ready\n");
		return 1;
	}
	printf("Gyroscope device ready: %s\n\n", gyro_dev->name);

	/* Main loop - read sensor data periodically */
	while (1) {
		/* Read accelerometer data */
		ret = sensor_sample_fetch(accel_dev);
		if (ret < 0) {
			printf("Error: Failed to fetch accelerometer sample: %d\n", ret);
		} else {
			ret = sensor_channel_get(accel_dev, SENSOR_CHAN_ACCEL_XYZ, accel);
			if (ret < 0) {
				printf("Error: Failed to get accelerometer data: %d\n", ret);
			} else {
				printf("Accelerometer - X: ");
				print_sensor_value(&accel[0]);
				printf(" m/s^2, Y: ");
				print_sensor_value(&accel[1]);
				printf(" m/s^2, Z: ");
				print_sensor_value(&accel[2]);
				printf(" m/s^2\n");
			}
		}

		/* Read gyroscope data */
		ret = sensor_sample_fetch(gyro_dev);
		if (ret < 0) {
			printf("Error: Failed to fetch gyroscope sample: %d\n", ret);
		} else {
			ret = sensor_channel_get(gyro_dev, SENSOR_CHAN_GYRO_XYZ, gyro);
			if (ret < 0) {
				printf("Error: Failed to get gyroscope data: %d\n", ret);
			} else {
				printf("Gyroscope     - X: ");
				print_sensor_value(&gyro[0]);
				printf(" rad/s, Y: ");
				print_sensor_value(&gyro[1]);
				printf(" rad/s, Z: ");
				print_sensor_value(&gyro[2]);
				printf(" rad/s\n");
			}
		}

		/* Read temperature from accelerometer */
		ret = sensor_channel_get(accel_dev, SENSOR_CHAN_DIE_TEMP, &temp);
		if (ret < 0) {
			printf("Error: Failed to get temperature: %d\n", ret);
		} else {
			printf("Temperature    - ");
			print_sensor_value(&temp);
			printf(" C\n");
		}

		printf("---\n");

		/* Wait before next reading */
		k_msleep(10);
	}

	return 0;
}
```
