## CMakeLists.txt
```
# SPDX-License-Identifier: Apache-2.0

cmake_minimum_required(VERSION 3.20.0)
find_package(Zephyr REQUIRED HINTS $ENV{ZEPHYR_BASE})
project(riskybird_mpc CXX)

if(NOT DEFINED RB_ROOT)
  get_filename_component(RB_ROOT "${CMAKE_CURRENT_SOURCE_DIR}/../.." ABSOLUTE)
endif()

if(RB_BOARD STREQUAL "rose-spike")
  if(NOT EXISTS "${RB_ROOT}/backends/RoSE/soc/sw/zephyr-rose/zephyr/module.yml")
    message(FATAL_ERROR "RoSE Zephyr module is missing")
  endif()
endif()

set(TINYMPC_DIR
  "${RB_ROOT}/backends/zephyr-chipyard-sw/samples/drone_control/tinympc")
if(NOT EXISTS "${TINYMPC_DIR}/external/admm/include/admm.hpp")
  message(FATAL_ERROR
    "Accelerated-TinyMPC is missing at ${TINYMPC_DIR}. "
    "Initialize the zephyr-chipyard-sw drone_control submodule.")
endif()

# The first FPGA workload targets the scalar Rocket present on both boards.
set(USE_CPU ON CACHE BOOL "Use scalar CPU matlib" FORCE)
set(USE_RVV OFF CACHE BOOL "Disable RVV" FORCE)
set(USE_RVVU OFF CACHE BOOL "Disable RVV unrolling" FORCE)
set(USE_HANDOPT OFF CACHE BOOL "Disable RVV hand optimization" FORCE)
set(MATLIB_EXTERNAL_BUILD ON CACHE BOOL "Zephyr owns compiler flags" FORCE)
include("${TINYMPC_DIR}/external/matlib/matlib_header.cmake")

# The KU040 shell deliberately uses a 32 KiB on-chip scratchpad. Preserve the
# full ten-step controller on Arty100T and use a three-step receding horizon on
# KU040 so the exact same model and cost matrices fit in physical memory.
if(RB_BOARD STREQUAL "ku040")
  target_compile_definitions(app PRIVATE NHORIZON=3)
endif()

target_sources(app PRIVATE
  src/main.cpp
  "${TINYMPC_DIR}/external/admm/src/admm_rvv.cpp"
)

target_include_directories(app PRIVATE
  "${CMAKE_CURRENT_SOURCE_DIR}/include"
  "${TINYMPC_DIR}/external/admm/include"
  "${TINYMPC_DIR}/external/matlib/include"
  "${TINYMPC_DIR}/examples"
)

target_compile_options(app PRIVATE
  $<$<COMPILE_LANGUAGE:CXX>:-std=c++17>
  $<$<COMPILE_LANGUAGE:CXX>:-include>
  $<$<COMPILE_LANGUAGE:CXX>:${CMAKE_CURRENT_SOURCE_DIR}/include/rb_tinympc_compat.h>
  -fno-tree-vectorize
  -fno-tree-loop-vectorize
  -fno-tree-slp-vectorize
)
target_link_libraries(app PRIVATE m)
```

## Kconfig
```
# SPDX-License-Identifier: Apache-2.0

mainmenu "RiskyBird MPC workload"

choice RB_MPC_INPUT
	prompt "MPC input transport"
	default RB_MPC_INPUT_REPLAY

config RB_MPC_INPUT_REPLAY
	bool "Deterministic compiled-in states"

config RB_MPC_INPUT_HIL
	bool "Binary UART HIL protocol"

config RB_MPC_INPUT_ROSE
	bool "RoSE bridge closed-loop protocol"

endchoice

config RB_MPC_REPLAY_PERIOD_MS
	int "Replay solve period"
	default 100
	range 10 10000
	depends on RB_MPC_INPUT_REPLAY

rsource "../../hardware/zephyr/Kconfig.fpga"

source "Kconfig.zephyr"
```

## prj.conf
```kconfig
CONFIG_CPP=y
CONFIG_REQUIRES_FULL_LIBCPP=n
CONFIG_MAIN_STACK_SIZE=2048
CONFIG_MULTITHREADING=n
CONFIG_STACK_SENTINEL=n
CONFIG_FPU_SHARING=n
CONFIG_TIMING_FUNCTIONS=y
CONFIG_CBPRINTF_FP_SUPPORT=n
```

## src/main.cpp
```c
/* SPDX-License-Identifier: Apache-2.0 */

#include <admm.hpp>
#include <problem_data/quadrotor_50hz_params_constrained.hpp>

#include <stddef.h>
#include <stdint.h>
#include <string.h>

#include <zephyr/device.h>
#include <zephyr/drivers/uart.h>
#include <zephyr/kernel.h>
#include <zephyr/sys/printk.h>
#include <zephyr/timing/timing.h>

#if defined(CONFIG_RB_MPC_INPUT_ROSE)
#include <rose/rose.h>
#include <rose/rose_proto.h>
#endif

namespace {

constexpr uint8_t kHeader[] = {0xDE, 0xAD, 0xBE, 0xEF};
constexpr int kStates = NSTATES;
constexpr int kActions = NINPUTS;

TinyCache cache;
TinyWorkspace workspace;
TinySettings settings;
TinySolver solver{&settings, &cache, &workspace};

void initialize_solver()
{
	tiny_init(&solver);

	cache.rho = rho_value;
	matsetv(cache.Kinf.data, Kinf_data, cache.Kinf.outer, cache.Kinf.inner);
	transpose(cache.Kinf.data, cache.KinfT.data, NINPUTS, NSTATES);
	matsetv(cache.Pinf.data, Pinf_data, cache.Pinf.outer, cache.Pinf.inner);
	transpose(cache.Pinf.data, cache.PinfT.data, NSTATES, NSTATES);
	matsetv(
		cache.Quu_inv.data,
		Quu_inv_data,
		cache.Quu_inv.outer,
		cache.Quu_inv.inner);
	matsetv(cache.AmBKt.data, AmBKt_data, cache.AmBKt.outer, cache.AmBKt.inner);
	transpose(cache.AmBKt.data, cache.AmBKtT.data, NSTATES, NSTATES);
	matsetv(
		cache.coeff_d2p.data,
		coeff_d2p_data,
		cache.coeff_d2p.outer,
		cache.coeff_d2p.inner);

	matsetv(
		workspace.Adyn.data,
		Adyn_data,
		workspace.Adyn.outer,
		workspace.Adyn.inner);
	transpose(workspace.Adyn.data, workspace.AdynT.data, NSTATES, NSTATES);
	matsetv(
		workspace.Bdyn.data,
		Bdyn_data,
		workspace.Bdyn.outer,
		workspace.Bdyn.inner);
	transpose(workspace.Bdyn.data, workspace.BdynT.data, NSTATES, NINPUTS);
	matsetv(workspace.Q.data, Q_data, workspace.Q.outer, workspace.Q.inner);
	matsetv(workspace.Qf.data, Qf_data, workspace.Qf.outer, workspace.Qf.inner);
	matsetv(workspace.R.data, R_data, workspace.R.outer, workspace.R.inner);

	matset(workspace.u_min.data, -0.583f, workspace.u_min.outer, workspace.u_min.inner);
	matset(
		workspace.u_max.data,
		1.0f - 0.583f,
		workspace.u_max.outer,
		workspace.u_max.inner);
	matset(workspace.x_min.data, -5.0f, workspace.x_min.outer, workspace.x_min.inner);
	matset(workspace.x_max.data, 5.0f, workspace.x_max.outer, workspace.x_max.inner);
	matset(workspace.Xref.data, 0.0f, workspace.Xref.outer, workspace.Xref.inner);
	matset(workspace.Uref.data, 0.0f, workspace.Uref.outer, workspace.Uref.inner);
}

uint32_t solve(const float state[kStates], float control[kActions], int *status)
{
	// The backend matlib predates const-correct input pointers; matsetv only
	// reads its second argument.
	matsetv(workspace.x.vector[0], const_cast<float *>(state), 1, NSTATES);
	matset(workspace.y.data, 0.0f, workspace.y.outer, workspace.y.inner);
	matset(workspace.g.data, 0.0f, workspace.g.outer, workspace.g.inner);

	timing_t start = timing_counter_get();
	*status = tiny_solve(&solver);
	timing_t end = timing_counter_get();
	for (int action = 0; action < kActions; action++) {
		control[action] = workspace.u.vector[0][action];
	}

	uint64_t cycles = timing_cycles_get(&start, &end);
	uint64_t nanoseconds = timing_cycles_to_ns(cycles);
	return nanoseconds > UINT32_MAX ? UINT32_MAX
				       : static_cast<uint32_t>(nanoseconds);
}

#if defined(CONFIG_RB_MPC_INPUT_HIL)

const struct device *const uart = DEVICE_DT_GET(DT_NODELABEL(uart0));

uint8_t receive_byte()
{
	uint8_t value;
	while (uart_poll_in(uart, &value) != 0) {
	}
	return value;
}

void receive_header()
{
	size_t matched = 0;
	while (matched < sizeof(kHeader)) {
		uint8_t value = receive_byte();
		matched = value == kHeader[matched] ? matched + 1
						  : (value == kHeader[0] ? 1 : 0);
	}
}

float receive_float()
{
	uint8_t bytes[sizeof(float)];
	float value;
	for (size_t index = 0; index < sizeof(bytes); index++) {
		bytes[index] = receive_byte();
	}
	memcpy(&value, bytes, sizeof(value));
	return value;
}

void send_bytes(const void *data, size_t size)
{
	const auto *bytes = static_cast<const uint8_t *>(data);
	for (size_t index = 0; index < size; index++) {
		uart_poll_out(uart, bytes[index]);
	}
}

void send_response(const float control[kActions], uint32_t nanoseconds)
{
	const uint8_t drone_id = 0;
	send_bytes(kHeader, sizeof(kHeader));
	send_bytes(&drone_id, sizeof(drone_id));
	send_bytes(control, sizeof(float) * kActions);
	send_bytes(&nanoseconds, sizeof(nanoseconds));
}

void run_hil()
{
	if (!device_is_ready(uart)) {
		return;
	}
	while (true) {
		receive_header();
		uint8_t drone_count = receive_byte();
		float state[kStates] = {};

		for (uint8_t drone = 0; drone < drone_count; drone++) {
			for (int index = 0; index < kStates; index++) {
				float value = receive_float();
				if (drone == 0) {
					state[index] = value;
				}
			}
		}
		if (drone_count == 0) {
			continue;
		}

		float control[kActions];
		int status;
		uint32_t nanoseconds = solve(state, control, &status);
		send_response(control, nanoseconds);
	}
}

#elif defined(CONFIG_RB_MPC_INPUT_ROSE)

constexpr uint32_t kRoseStateCommand = 0x12U;
constexpr uint32_t kRoseThrustCommand = 0x20U;
constexpr uint8_t kRoseStateChannel = 2U;

const struct device *const rose = DEVICE_DT_GET_ONE(ucbbar_roseadapter);

bool receive_rose_state(float state[kStates])
{
	uint32_t words[kStates];
	if (rose_request(rose, kRoseStateCommand, 0U) != 0) {
		return false;
	}
	int received = rose_recv_reqrsp(
		rose, kRoseStateChannel, words, kStates);
	if (received != kStates) {
		return false;
	}
	memcpy(state, words, sizeof(words));
	return true;
}

bool send_rose_control(const float control[kActions])
{
	if (rose_tx(rose, kRoseThrustCommand) != 0 ||
	    rose_tx(rose, sizeof(float) * kActions) != 0) {
		return false;
	}
	for (int index = 0; index < kActions; index++) {
		uint32_t word;
		memcpy(&word, &control[index], sizeof(word));
		if (rose_tx(rose, word) != 0) {
			return false;
		}
	}
	return true;
}

void run_rose()
{
	if (!device_is_ready(rose)) {
		printk("RB_MPC_ROSE error=device_not_ready\n");
		return;
	}
	printk(
		"RB_MPC_ROSE ready states=%d actions=%d horizon=%d\n",
		NSTATES,
		NINPUTS,
		NHORIZON);
	uint32_t iteration = 0;
	while (true) {
		float state[kStates];
		if (!receive_rose_state(state)) {
			printk("RB_MPC_ROSE error=state_receive\n");
			continue;
		}
		float control[kActions];
		int status;
		uint32_t nanoseconds = solve(state, control, &status);
		if (!send_rose_control(control)) {
			printk("RB_MPC_ROSE error=control_send\n");
			continue;
		}
		iteration++;
		printk(
			"RB_MPC_ROSE iter=%u status=%d z_milli=%d solve_ns=%u\n",
			iteration,
			status,
			static_cast<int>(state[2] * 1000.0f),
			nanoseconds);
	}
}

#else

int milli(float value)
{
	return static_cast<int>(value * 1000.0f);
}

constexpr float kReplayStates[][kStates] = {
	{0.0f, 0.0f, 0.0f, 0.0f, 0.0f, 0.0f,
	 0.0f, 0.0f, 0.0f, 0.0f, 0.0f, 0.0f},
	{0.25f, -0.10f, 0.15f, 0.02f, -0.03f, 0.01f,
	 0.05f, -0.02f, 0.01f, 0.0f, 0.0f, 0.0f},
	{-0.20f, 0.20f, -0.10f, -0.01f, 0.04f, -0.02f,
	 -0.03f, 0.04f, -0.02f, 0.0f, 0.0f, 0.0f},
};

void run_replay()
{
	uint32_t sequence = 0;
	while (true) {
		const float *state =
			kReplayStates[sequence % (sizeof(kReplayStates) / sizeof(kReplayStates[0]))];
		float control[kActions];
		int status;
		uint32_t nanoseconds = solve(state, control, &status);

		printk(
			"RB_MPC seq=%u status=%d u_milli=%d,%d,%d,%d solve_ns=%u\n",
			sequence,
			status,
			milli(control[0]),
			milli(control[1]),
			milli(control[2]),
			milli(control[3]),
			nanoseconds);
		sequence++;
		k_busy_wait(CONFIG_RB_MPC_REPLAY_PERIOD_MS * 1000);
	}
}

#endif

}  // namespace

int main()
{
	timing_init();
	timing_start();
	initialize_solver();

#if defined(CONFIG_RB_MPC_INPUT_HIL)
	run_hil();
#elif defined(CONFIG_RB_MPC_INPUT_ROSE)
	run_rose();
#else
	printk(
		"RB_MPC ready mode=replay states=%d actions=%d horizon=%d workspace_bytes=%u\n",
		NSTATES,
		NINPUTS,
		NHORIZON,
		static_cast<unsigned int>(sizeof(TinyWorkspace)));
	run_replay();
#endif
	return 0;
}
```

## include/rb_tinympc_compat.h
```c
/* SPDX-License-Identifier: Apache-2.0 */

#ifndef RB_TINYMPC_COMPAT_H_
#define RB_TINYMPC_COMPAT_H_

/*
 * Accelerated-TinyMPC expects the full C math header. Zephyr's minimal libc
 * intentionally exposes only sqrt/sqrtf. The solver's scalar code only needs
 * absolute value, so map it to the compiler builtin without adding a symbol
 * that can conflict with a later C-library declaration.
 */
#define fabs(value) __builtin_fabs(value)

#ifndef RAND_MAX
#define RAND_MAX 2147483647
extern "C" int rand(void);
#endif

#endif /* RB_TINYMPC_COMPAT_H_ */
```
