## CMakeLists.txt
```
# SPDX-License-Identifier: Apache-2.0

cmake_minimum_required(VERSION 3.20.0)
find_package(Zephyr REQUIRED HINTS $ENV{ZEPHYR_BASE})
project(riskybird_state)

target_sources(app PRIVATE
  src/main.c
  src/madgwick.c
)

target_sources_ifdef(CONFIG_RB_STATE_SOURCE_REPLAY app PRIVATE src/imu_replay.c)
target_sources_ifdef(CONFIG_RB_STATE_SOURCE_BMI088 app PRIVATE src/imu_bmi088.c)
target_include_directories(app PRIVATE include)
target_link_libraries(app PRIVATE m)
```

## Kconfig
```
# SPDX-License-Identifier: Apache-2.0

mainmenu "RiskyBird state-estimation workload"

choice RB_STATE_SOURCE
	prompt "IMU input source"
	default RB_STATE_SOURCE_REPLAY

config RB_STATE_SOURCE_REPLAY
	bool "Deterministic compiled-in replay"

config RB_STATE_SOURCE_BMI088
	bool "BMI088 over the FPGA I2C controller"

endchoice

config RB_STATE_RATE_HZ
	int "Estimator update frequency"
	default 200
	range 10 1000

config RB_STATE_BETA_MILLI
	int "Madgwick beta, in thousandths"
	default 100
	range 0 2000

config RB_STATE_CALIBRATION_SAMPLES
	int "Stationary gyro samples used for BMI088 bias calibration"
	default 100
	range 0 2000
	depends on RB_STATE_SOURCE_BMI088

rsource "../../hardware/zephyr/Kconfig.fpga"

source "Kconfig.zephyr"
```

## prj.conf
```kconfig
CONFIG_MAIN_STACK_SIZE=2048
CONFIG_PRINTK=y
CONFIG_MULTITHREADING=y
CONFIG_FPU_SHARING=y
CONFIG_CBPRINTF_FP_SUPPORT=n
CONFIG_TIMING_FUNCTIONS=y
```

## src/main.c
```c
/* SPDX-License-Identifier: Apache-2.0 */

#include "rb_imu.h"
#include "rb_madgwick.h"

#include <stdint.h>
#include <zephyr/kernel.h>
#include <zephyr/sys/printk.h>
#include <zephyr/timing/timing.h>

#define RAD_TO_MILLIDEG 57295.7795f

static int32_t to_milli(float value)
{
	return (int32_t)(value * 1000.0f);
}

int main(void)
{
	struct rb_madgwick filter;
	struct rb_imu_sample sample;
	uint32_t sequence = 0;
	int64_t previous_us = 0;
	int result = rb_imu_init();

	if (result != 0) {
		printk("RB_STATE error=imu_init code=%d\n", result);
		return result;
	}

	rb_madgwick_init(&filter, (float)CONFIG_RB_STATE_BETA_MILLI / 1000.0f);
	timing_init();
	timing_start();
	printk("RB_STATE ready source=%s rate_hz=%d beta_milli=%d\n",
	       rb_imu_source_name(), CONFIG_RB_STATE_RATE_HZ,
	       CONFIG_RB_STATE_BETA_MILLI);

	while (true) {
		int64_t now_us = k_ticks_to_us_floor64(k_uptime_ticks());
		float dt = previous_us == 0
				   ? 1.0f / (float)CONFIG_RB_STATE_RATE_HZ
				   : (float)(now_us - previous_us) / 1000000.0f;
		previous_us = now_us;

		result = rb_imu_read(&sample);
		if (result != 0) {
			printk("RB_STATE error=imu_read code=%d seq=%u\n", result, sequence);
			k_msleep(10);
			continue;
		}

		timing_t start = timing_counter_get();
		rb_madgwick_update_imu(
			&filter,
			sample.gyro_rps[0],
			sample.gyro_rps[1],
			sample.gyro_rps[2],
			sample.accel_mps2[0],
			sample.accel_mps2[1],
			sample.accel_mps2[2],
			dt);
		timing_t end = timing_counter_get();

		if ((sequence % (CONFIG_RB_STATE_RATE_HZ / 10)) == 0U) {
			struct rb_euler euler;
			uint64_t cycles = timing_cycles_get(&start, &end);

			rb_madgwick_euler(&filter, &euler);
			printk(
				"RB_STATE seq=%u q_milli=%d,%d,%d,%d "
				"euler_mdeg=%d,%d,%d update_ns=%llu\n",
				sequence,
				to_milli(filter.q[0]),
				to_milli(filter.q[1]),
				to_milli(filter.q[2]),
				to_milli(filter.q[3]),
				(int32_t)(euler.roll * RAD_TO_MILLIDEG),
				(int32_t)(euler.pitch * RAD_TO_MILLIDEG),
				(int32_t)(euler.yaw * RAD_TO_MILLIDEG),
				(unsigned long long)timing_cycles_to_ns(cycles));
		}
		sequence++;
		k_usleep(1000000U / CONFIG_RB_STATE_RATE_HZ);
	}
	return 0;
}
```

## include/rb_imu.h
```c
/* SPDX-License-Identifier: Apache-2.0 */

#ifndef RB_IMU_H
#define RB_IMU_H

struct rb_imu_sample {
	float accel_mps2[3];
	float gyro_rps[3];
};

int rb_imu_init(void);
int rb_imu_read(struct rb_imu_sample *sample);
const char *rb_imu_source_name(void);

#endif
```

## include/rb_madgwick.h
```c
/* SPDX-License-Identifier: Apache-2.0 */

#ifndef RB_MADGWICK_H
#define RB_MADGWICK_H

struct rb_madgwick {
	float q[4];
	float beta;
};

struct rb_euler {
	float roll;
	float pitch;
	float yaw;
};

void rb_madgwick_init(struct rb_madgwick *filter, float beta);
void rb_madgwick_update_imu(
	struct rb_madgwick *filter,
	float gx,
	float gy,
	float gz,
	float ax,
	float ay,
	float az,
	float dt);
void rb_madgwick_euler(const struct rb_madgwick *filter, struct rb_euler *euler);

#endif
```

## src/imu_bmi088.c
```c
/* SPDX-License-Identifier: Apache-2.0 */

#include "rb_imu.h"

#include <errno.h>
#include <zephyr/device.h>
#include <zephyr/devicetree.h>
#include <zephyr/drivers/sensor.h>
#include <zephyr/kernel.h>

#define BMI088_ACCEL_NODE DT_ALIAS(bmi088_accel)
#define BMI088_GYRO_NODE DT_ALIAS(bmi088_gyro)

#if !DT_NODE_EXISTS(BMI088_ACCEL_NODE)
#error "RiskyBird FPGA overlay must define the bmi088-accel alias"
#endif

#if !DT_NODE_EXISTS(BMI088_GYRO_NODE)
#error "RiskyBird FPGA overlay must define the bmi088-gyro alias"
#endif

static const struct device *const accel = DEVICE_DT_GET(BMI088_ACCEL_NODE);
static const struct device *const gyro = DEVICE_DT_GET(BMI088_GYRO_NODE);
static float gyro_bias[3];

static int read_uncalibrated(struct rb_imu_sample *sample)
{
	struct sensor_value accel_values[3];
	struct sensor_value gyro_values[3];
	int result = sensor_sample_fetch(accel);

	if (result != 0) {
		return result;
	}
	result = sensor_channel_get(accel, SENSOR_CHAN_ACCEL_XYZ, accel_values);
	if (result != 0) {
		return result;
	}
	result = sensor_sample_fetch(gyro);
	if (result != 0) {
		return result;
	}
	result = sensor_channel_get(gyro, SENSOR_CHAN_GYRO_XYZ, gyro_values);
	if (result != 0) {
		return result;
	}

	for (size_t axis = 0; axis < 3; axis++) {
		sample->accel_mps2[axis] = (float)sensor_value_to_double(&accel_values[axis]);
		sample->gyro_rps[axis] = (float)sensor_value_to_double(&gyro_values[axis]);
	}
	return 0;
}

int rb_imu_init(void)
{
	if (!device_is_ready(accel) || !device_is_ready(gyro)) {
		return -ENODEV;
	}

	for (size_t axis = 0; axis < 3; axis++) {
		gyro_bias[axis] = 0.0f;
	}

	for (int sample_index = 0; sample_index < CONFIG_RB_STATE_CALIBRATION_SAMPLES;
	     sample_index++) {
		struct rb_imu_sample sample;
		int result = read_uncalibrated(&sample);

		if (result != 0) {
			return result;
		}
		for (size_t axis = 0; axis < 3; axis++) {
			gyro_bias[axis] += sample.gyro_rps[axis];
		}
		k_msleep(5);
	}

	if (CONFIG_RB_STATE_CALIBRATION_SAMPLES > 0) {
		for (size_t axis = 0; axis < 3; axis++) {
			gyro_bias[axis] /= (float)CONFIG_RB_STATE_CALIBRATION_SAMPLES;
		}
	}
	return 0;
}

int rb_imu_read(struct rb_imu_sample *sample)
{
	int result = read_uncalibrated(sample);

	if (result == 0) {
		for (size_t axis = 0; axis < 3; axis++) {
			sample->gyro_rps[axis] -= gyro_bias[axis];
		}
	}
	return result;
}

const char *rb_imu_source_name(void)
{
	return "bmi088";
}
```

## src/imu_replay.c
```c
/* SPDX-License-Identifier: Apache-2.0 */

#include "rb_imu.h"

#include <stddef.h>

#define GRAVITY_MPS2 9.80665f
#define YAW_RATE_RPS 0.5235988f

static unsigned int replay_index;

int rb_imu_init(void)
{
	replay_index = 0;
	return 0;
}

int rb_imu_read(struct rb_imu_sample *sample)
{
	if (sample == NULL) {
		return -1;
	}

	sample->accel_mps2[0] = 0.0f;
	sample->accel_mps2[1] = 0.0f;
	sample->accel_mps2[2] = GRAVITY_MPS2;
	sample->gyro_rps[0] = 0.0f;
	sample->gyro_rps[1] = 0.0f;
	/* One second still, one second at 30 degrees/s, then repeat. */
	const unsigned int one_second = CONFIG_RB_STATE_RATE_HZ;
	sample->gyro_rps[2] =
		(replay_index % (2U * one_second)) >= one_second ? YAW_RATE_RPS : 0.0f;
	replay_index++;
	return 0;
}

const char *rb_imu_source_name(void)
{
	return "replay";
}
```

## src/madgwick.c
```c
/* SPDX-License-Identifier: Apache-2.0 */

#include "rb_madgwick.h"

#include <math.h>
#include <stddef.h>

#define RB_NORM_EPSILON 1.0e-12f
#define RB_PI_OVER_4 0.7853981634f
#define RB_THREE_PI_OVER_4 2.3561944902f

static float inverse_norm(float value)
{
	if (value <= RB_NORM_EPSILON) {
		return 0.0f;
	}
	return 1.0f / sqrtf(value);
}

/* A compact atan2 approximation is sufficient for human-readable Euler
 * telemetry. The estimator state itself remains the normalized quaternion. */
static float approximate_atan2(float y, float x)
{
	float absolute_y = y < 0.0f ? -y : y;
	float ratio;
	float angle;

	absolute_y += 1.0e-10f;
	if (x < 0.0f) {
		ratio = (x + absolute_y) / (absolute_y - x);
		angle = RB_THREE_PI_OVER_4;
	} else {
		ratio = (x - absolute_y) / (x + absolute_y);
		angle = RB_PI_OVER_4;
	}
	angle += (0.1963f * ratio * ratio - 0.9817f) * ratio;
	return y < 0.0f ? -angle : angle;
}

void rb_madgwick_init(struct rb_madgwick *filter, float beta)
{
	filter->q[0] = 1.0f;
	filter->q[1] = 0.0f;
	filter->q[2] = 0.0f;
	filter->q[3] = 0.0f;
	filter->beta = beta;
}

void rb_madgwick_update_imu(
	struct rb_madgwick *filter,
	float gx,
	float gy,
	float gz,
	float ax,
	float ay,
	float az,
	float dt)
{
	float q0 = filter->q[0];
	float q1 = filter->q[1];
	float q2 = filter->q[2];
	float q3 = filter->q[3];
	float q_dot0 = 0.5f * (-q1 * gx - q2 * gy - q3 * gz);
	float q_dot1 = 0.5f * (q0 * gx + q2 * gz - q3 * gy);
	float q_dot2 = 0.5f * (q0 * gy - q1 * gz + q3 * gx);
	float q_dot3 = 0.5f * (q0 * gz + q1 * gy - q2 * gx);
	float accel_recip = inverse_norm(ax * ax + ay * ay + az * az);

	if (accel_recip > 0.0f) {
		ax *= accel_recip;
		ay *= accel_recip;
		az *= accel_recip;

		float two_q0 = 2.0f * q0;
		float two_q1 = 2.0f * q1;
		float two_q2 = 2.0f * q2;
		float two_q3 = 2.0f * q3;
		float four_q0 = 4.0f * q0;
		float four_q1 = 4.0f * q1;
		float four_q2 = 4.0f * q2;
		float eight_q1 = 8.0f * q1;
		float eight_q2 = 8.0f * q2;
		float q0q0 = q0 * q0;
		float q1q1 = q1 * q1;
		float q2q2 = q2 * q2;
		float q3q3 = q3 * q3;

		float s0 = four_q0 * q2q2 + two_q2 * ax +
			   four_q0 * q1q1 - two_q1 * ay;
		float s1 = four_q1 * q3q3 - two_q3 * ax +
			   4.0f * q0q0 * q1 - two_q0 * ay - four_q1 +
			   eight_q1 * q1q1 + eight_q1 * q2q2 + four_q1 * az;
		float s2 = 4.0f * q0q0 * q2 + two_q0 * ax +
			   four_q2 * q3q3 - two_q3 * ay - four_q2 +
			   eight_q2 * q1q1 + eight_q2 * q2q2 + four_q2 * az;
		float s3 = 4.0f * q1q1 * q3 - two_q1 * ax +
			   4.0f * q2q2 * q3 - two_q2 * ay;
		float step_recip = inverse_norm(s0 * s0 + s1 * s1 + s2 * s2 + s3 * s3);

		if (step_recip > 0.0f) {
			q_dot0 -= filter->beta * s0 * step_recip;
			q_dot1 -= filter->beta * s1 * step_recip;
			q_dot2 -= filter->beta * s2 * step_recip;
			q_dot3 -= filter->beta * s3 * step_recip;
		}
	}

	q0 += q_dot0 * dt;
	q1 += q_dot1 * dt;
	q2 += q_dot2 * dt;
	q3 += q_dot3 * dt;

	float quaternion_recip = inverse_norm(q0 * q0 + q1 * q1 + q2 * q2 + q3 * q3);
	if (quaternion_recip == 0.0f) {
		rb_madgwick_init(filter, filter->beta);
		return;
	}
	filter->q[0] = q0 * quaternion_recip;
	filter->q[1] = q1 * quaternion_recip;
	filter->q[2] = q2 * quaternion_recip;
	filter->q[3] = q3 * quaternion_recip;
}

void rb_madgwick_euler(const struct rb_madgwick *filter, struct rb_euler *euler)
{
	const float q0 = filter->q[0];
	const float q1 = filter->q[1];
	const float q2 = filter->q[2];
	const float q3 = filter->q[3];
	float pitch_sine = 2.0f * (q0 * q2 - q3 * q1);

	if (pitch_sine > 1.0f) {
		pitch_sine = 1.0f;
	} else if (pitch_sine < -1.0f) {
		pitch_sine = -1.0f;
	}

	euler->roll = approximate_atan2(
		2.0f * (q0 * q1 + q2 * q3),
		1.0f - 2.0f * (q1 * q1 + q2 * q2));
	euler->pitch = approximate_atan2(
		pitch_sine,
		sqrtf(1.0f - pitch_sine * pitch_sine));
	euler->yaw = approximate_atan2(
		2.0f * (q0 * q3 + q1 * q2),
		1.0f - 2.0f * (q2 * q2 + q3 * q3));
}
```
