## riskybird/hardware/zephyr/Kconfig.workload
```kconfig
# SPDX-License-Identifier: Apache-2.0

mainmenu "RiskyBird Zephyr workload"

rsource "Kconfig.fpga"

source "Kconfig.zephyr"
```

## riskybird/hardware/zephyr/dts/bindings/riskybird,pmw3901.yaml
```yaml
# SPDX-License-Identifier: Apache-2.0

description: RiskyBird PMW3901 board-wiring contract

compatible: "riskybird,pmw3901"

properties:
  spi-bus:
    type: phandle
    required: true
    description: SPI controller used for PMW3901 register transfers

  cs-gpios:
    type: phandle-array
    required: true

  reset-gpios:
    type: phandle-array
    required: true

  led-gpios:
    type: phandle-array
    required: true
```

## riskybird/workloads/ads7128_test/sample.yaml
```yaml
sample:
  description: RiskyBird ADS7128 register and GPIO diagnostic
  name: ads7128 diagnostic
common:
  tags: i2c adc sensor riskybird
tests: {}
```

## riskybird/workloads/i2c_scanner/sample.yaml
```yaml
sample:
  description: RiskyBird target-independent I2C address scanner
  name: i2c scanner
common:
  tags: i2c riskybird
tests: {}
```

## zephyr_ws/manifest/west.yml
```yaml
# Canonical workspace is zephyr_ws; bootstrap with scripts/bootstrap-riskybird.sh.
manifest:
  projects:
    - name: zephyr
      url: https://github.com/lorenshung/zephyr.git
      revision: ed44a090074550505f3ba2449215ccba49f8e52e
      path: zephyr
      import: west-riscv.yml
    - name: zephyr-rose
      url: https://github.com/ucb-bar/zephyr-rose.git
      revision: f7e2beef55e8d7176a16b0af01a538155e59f39e
      path: modules/lib/zephyr-rose
    - name: xnnpack
      url: https://github.com/ucb-bar/XNNPACK.git
      revision: 43e0628fb50db8097a44ebb0b4292ac1561fc657
      path: modules/lib/xnnpack
    - name: executorch
      url: https://github.com/ucb-bar/executorch.git
      revision: 54af43112622263bc77cd2bb867b1d6b29bce934
      path: modules/lib/executorch
  self:
    path: manifest
```
