/*
 * SPDX-License-Identifier: Apache-2.0
 *
 * ADS7128 is configured at I2C address 0x17.
 * Reference: ADS7128 datasheet (SBAS868A)
 */

&i2c0 {
	/* ADS7128 I2C ADC Expander at address 0x17
	 * Note: ADS7128 doesn't have a standard Zephyr driver yet,
	 * so we're just validating I2C communication.
	 * The device tree node is optional but helps document the hardware.
	 */
	ads7128@17 {
		compatible = "ti,ads7128";
		reg = <0x17>;
		status = "okay";
	};
};
